## config/west.yml
```yaml
manifest:
  remotes:
  - name: zmkfirmware
    url-base: https://github.com/lynnlee0522
  - name: nxtkb
    url-base: https://github.com/nxtkb
  projects:
  - name: zmk
    remote: zmkfirmware
    revision: ink_rotation
    import: app/west.yml
  - name: zmk-behavior-report
    remote: nxtkb
    revision: main
    import: west.yml
  self:
    path: config
```
